/* U.N.S.Udawaththa
  AS2019961*/


/*Include Libraries*/

#include <FlagPCM.h>  // Include PCM library 
#include <Servo.h> //Include Servo Library
#include <SoftwareSerial.h> //Include softwareSerial library 

SoftwareSerial mySerial(3, 2);// Define Rx and Tx
Servo myservo; 

/*Define Digital Pins*/

#define t 4 // D4 pin Bottom IR Sensor Input 
#define u 5 //D5 Top IR Sensor Input 
#define v 6 //D6 BEEP + 

int count1=0; //Data type for count1

/*Encoded Sample Values for Voice*/

const unsigned char sample[] PROGMEM = {
126, 131, 138, 138, 138, 137, 138, 143, 146, 146, 147, 148,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 128, 128};

/*Initiate functions*/

void updateSerial();  // Function for Update the Srial monitor and GSM serial monitor
void DisplaySensorValues(); // Function for display sensor output states
void BabyCareMode(); // Function for activated door locking system 


/*Serial monitor update*/

void updateSerial()
{
  delay(500);
  while (Serial.available()) 
  {
    mySerial.write(Serial.read());//Forward what Serial received to Software Serial Port
  }
  while(mySerial.available()) 
  {
    Serial.write(mySerial.read());//Forward what Software Serial received to Serial Port
  }
}

/*Show Sensor Status*/

void DisplaySensorValues()
{
Serial.print("Botom Sensor Active Value = "); //Show Bottom Sensor Active Value
Serial.println(digitalRead(t)); // Print that value to serial monitor
Serial.print("Top Sensor Active Value = "); //Show top Sensor Active Value
Serial.println(digitalRead(u)); // Print that value to serial monitor 
}

/*Activate Door close when baby come*/

void BabyCareMode()
{
while(count1<1){
 if(digitalRead(t)==1 && digitalRead(u)==0){ // Get Bottom Sensor and Top sensor status value
   count1 = count1+1;
   myservo.write(-180); //Close the door
   for(int k=0;k<5;k++){ // Activate the Buzzer
     digitalWrite(v,HIGH);
     delay(500);
     digitalWrite(v,LOW);
     delay(500); 
   }
   playback(sample, sizeof(sample)); // Activate the mother's Sound
   Serial.begin(9600);
   mySerial.begin(9600);
   Serial.println("Initializing..."); 
   delay(1000);
   mySerial.println("AT");
   delay(500);
   updateSerial();
   mySerial.println("AT+CMGF=1"); //Activate the send SMS  mode
   delay(500);
   updateSerial();
   mySerial.println("AT+CMGS=\"+94768661852\""); // enter your phone number here (prefix country code)
   delay(500);
   updateSerial();
   mySerial.print(" Baby is crossing the door, please pick up"); // enter your message here
   delay(500);
   updateSerial();
   mySerial.write(26);
   delay(10000); //Add delay 10 s to keep status on sensor reamin same
  }    
 }
if(digitalRead(t)==1 && count1==1 && digitalRead(u)==0) // Door open when Baby come back to Room
{
 myservo.write(90);
 delay(10000); // Add delay 10 s to keep status on sensor reamin same
 count1=0; 
}  
}

  /*Setup Loop*/
  
void setup() 
{  
  pinMode(t, INPUT); // Define t as input
  pinMode(u, INPUT);// Define u as input
  pinMode(v, OUTPUT);// Define v as input
  Serial.begin(9600);//Initiate Serial Monitor 
  mySerial.begin(9600);//Initiate GSM Serial Monitor
  myservo.attach(9);//Attach 9 pin to Servo Motor
}

/*main Loop*/

void loop(){
 
void DisplaySensorValues(); //Show Sensor Values in LOOP
void BabyCareMode(); //Activate Baby Care Door in LOOP

}
